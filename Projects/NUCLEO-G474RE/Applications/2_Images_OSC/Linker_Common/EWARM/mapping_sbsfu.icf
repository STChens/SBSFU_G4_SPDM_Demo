/*###ICF### Set of symbols used in SE and SB_SFU projects ****/

/******************************************************************************/
/*                              ROM section                                   */
/******************************************************************************/

/* SE Code region protected area */
define exported symbol __ICFEDIT_SE_Code_region_ROM_start__       = 0x08000200;
define exported symbol __ICFEDIT_SE_CallGate_region_ROM_start__   = __ICFEDIT_SE_Code_region_ROM_start__ + 4;
define exported symbol __ICFEDIT_SE_CallGate_Region_ROM_End__     = __ICFEDIT_SE_Code_region_ROM_start__ + 0x1FF;

/* SE key region protected area */
define exported symbol __ICFEDIT_SE_Key_region_ROM_start__        = __ICFEDIT_SE_CallGate_Region_ROM_End__ + 1;    /* PCROP protection : Alignment on 64 bytes */
define exported symbol __ICFEDIT_SE_Key_region_ROM_end__          = __ICFEDIT_SE_Key_region_ROM_start__ + 0x11FF;    /* PCROP protection : Minimum size is 4608 bytes for 8 key sets and hashes*/

/* SE Startup: call before enabling protected area */
define exported symbol __ICFEDIT_SE_Startup_region_ROM_start__    = __ICFEDIT_SE_Key_region_ROM_end__ + 1;
define exported symbol __ICFEDIT_SE_Code_nokey_region_ROM_start__ = __ICFEDIT_SE_Startup_region_ROM_start__ + 0x100;
/* Aligned SE End at the end of the 1st 24Kbytes of flash, MPU protection isolation constraints */
define exported symbol __ICFEDIT_SE_Code_region_ROM_end__         = 0x0800AFFF;

/* SE IF ROM: used to locate Secure Engine interface code out of protected area */
define exported symbol __ICFEDIT_SE_IF_region_ROM_start__         = __ICFEDIT_SE_Code_region_ROM_end__ + 1;
define exported symbol __ICFEDIT_SE_IF_region_ROM_end__           = __ICFEDIT_SE_IF_region_ROM_start__ + 0x5FF;

/* Secure memory activation code - initialization area */
define exported symbol __ICFEDIT_SB_HDP_region_ROM_start__        = __ICFEDIT_SE_IF_region_ROM_end__ + 1;
define exported symbol __ICFEDIT_SB_HDP_region_ROM_end__          = __ICFEDIT_SB_HDP_region_ROM_start__ + 0xFF;

/* SBSFU Code region */
define exported symbol __ICFEDIT_SB_region_ROM_start__            = __ICFEDIT_SB_HDP_region_ROM_end__ + 1;
/* Aligned SBSFU end at the end of the 1st 64Kbytes of FLASH, MPU protection isolation constraints */
define exported symbol __ICFEDIT_SB_region_ROM_end__              = 0x08012FFF;

/* ROM regions definition : ordered  */
define region SE_Entry_Secure_ROM_Region = mem:[from __ICFEDIT_SE_Code_region_ROM_start__ to __ICFEDIT_SE_CallGate_Region_ROM_End__];
define region SE_Key_ROM_region          = mem:[from __ICFEDIT_SE_Key_region_ROM_start__ to __ICFEDIT_SE_Key_region_ROM_end__];
define region SE_ROM_region              = mem:[from __ICFEDIT_SE_Code_nokey_region_ROM_start__ to __ICFEDIT_SE_Code_region_ROM_end__];
define region SE_IF_ROM_region           = mem:[from __ICFEDIT_SE_IF_region_ROM_start__ to __ICFEDIT_SE_IF_region_ROM_end__];
define region SB_HDP_ROM_region          = mem:[from __ICFEDIT_SB_HDP_region_ROM_start__ to __ICFEDIT_SB_HDP_region_ROM_end__];
define region SB_ROM_region              = mem:[from __ICFEDIT_SB_region_ROM_start__ to __ICFEDIT_SB_region_ROM_end__];

/******************************************************************************/
/*                              RAM section                                   */
/*                                                                            */
/******************************************************************************/

/* SE RAM1 region protected area */
/* SE stack is placed 1st in RAM, stack overflow does not write on other RAM area */
define exported symbol __ICFEDIT_SE_region_RAM_start__     = 0x20014000;
define exported symbol __ICFEDIT_SE_region_RAM_stack_top__ = 0x20014400; /* Secure Engine's private stack */
define exported symbol __ICFEDIT_SE_region_RAM_end__       = 0x200193FF;

/* Secure memory activation code area - execution in RAM */
define exported symbol __ICFEDIT_SB_HDP_Code_region_RAM_start__ = __ICFEDIT_SE_region_RAM_end__ + 1;
define exported symbol __ICFEDIT_SB_HDP_Code_region_RAM_end__   = __ICFEDIT_SB_HDP_Code_region_RAM_start__ + 0xFF;

/* SBSFU RAM region */
define exported symbol __ICFEDIT_SB_region_RAM_start__ = __ICFEDIT_SB_HDP_Code_region_RAM_end__ + 1;
define exported symbol __ICFEDIT_SB_region_RAM_end__   = 0x2001FFFF;

/* Shared RAM for Image State Handling */
define exported symbol __ICFEDIT_SB_FWIMG_STATE_region_RAM_start__ = __ICFEDIT_SB_region_RAM_end__ + 1;
define exported symbol __ICFEDIT_SB_FWIMG_STATE_region_RAM_end__   = 0x2001FFFF;

/* RAM regions definition */
define region SE_RAM_region    = mem:[from __ICFEDIT_SE_region_RAM_stack_top__ to __ICFEDIT_SE_region_RAM_end__];
define region SB_HDP_CODE_RAM_region = mem:[from __ICFEDIT_SB_HDP_Code_region_RAM_start__ to __ICFEDIT_SB_HDP_Code_region_RAM_end__];
define region SB_RAM_region    = mem:[from __ICFEDIT_SB_region_RAM_start__ to __ICFEDIT_SB_region_RAM_end__];
define region SB_FWIMG_STATE_RAM_region = mem:[from __ICFEDIT_SB_FWIMG_STATE_region_RAM_start__ to __ICFEDIT_SB_FWIMG_STATE_region_RAM_end__];
